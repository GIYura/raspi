/dts-v1/;
/plugin/;
/ {
    compatible = "brcm,bcm2711";
    fragment@0 {
        target = <&uart1>;
        __overlay__ {
            echodev {
                compatible = "brightlight,echodev";
                status = "okay";
            };
        };
    };
};
